## tests/drivers/interrupt_controller/stm32_syscfg_itline/testcase.yaml
```yaml
# Copyright (c) 2024 Meta
# SPDX-License-Identifier: Apache-2.0

common:
  tags:
    - drivers
    - interrupt
  filter: CONFIG_MULTI_LEVEL_INTERRUPTS
  platform_allow:
    - nucleo_g0b1re
tests:
  # interrupt_controller.stm32_syscfg_itline.default: {}
  interrupt_controller.stm32_syscfg_itline.ztest:
    build_only: true
```
